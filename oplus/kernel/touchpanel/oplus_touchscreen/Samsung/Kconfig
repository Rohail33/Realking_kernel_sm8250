## oplus/kernel/touchpanel/oplus_touchscreen/Samsung/Kconfig
```kconfig
source "drivers/input/touchscreen/oplus_touchscreen/Samsung/S6SY791/Kconfig"
source "drivers/input/touchscreen/oplus_touchscreen/Samsung/S6SY771/Kconfig"
```

## oplus/kernel/touchpanel/oplus_touchscreen/Samsung/S6SY771/Kconfig
```kconfig
#ifdef OPLUS_FEATURE_TP_BASIC


config TOUCHPANEL_SAMSUNG_S6SY771
#	default y
	bool "TP Samsung s6sy771 IC enable or not for OPLUS"
	---help---
	say Y to enable driver for Touchpanel using Samsung s6sy771

#endif
```

## oplus/kernel/touchpanel/oplus_touchscreen/Samsung/S6SY791/Kconfig
```kconfig
#ifdef OPLUS_FEATURE_TP_BASIC


config TOUCHPANEL_SAMSUNG_S6SY791
#	default y
	bool "TP Samsung s6sy791 IC enable or not for OPLUS"
	---help---
	say Y to enable driver for Touchpanel using Samsung s6sy791

#endif
```

## oplus/kernel/touchpanel/oplus_touchscreen/Synaptics/Kconfig
```kconfig
source "drivers/input/touchscreen/oplus_touchscreen/Synaptics/S3706/Kconfig"
source "drivers/input/touchscreen/oplus_touchscreen/Synaptics/Syna_tcm_oncell/Kconfig"
```

## oplus/kernel/touchpanel/oplus_touchscreen/Synaptics/Syna_tcm_oncell/Kconfig
```kconfig
#
# Synaptics TCM touchscreen driver configuration
#
config TOUCHPANEL_SYNAPTICS_TCM_ONCELL
	bool "Synaptics TCM touchscreen"
	default n
	help
	  Say Y here if you have a Synaptics TCM touchscreen connected
	  to your system.

	  If unsure, say N.
```

## oplus/secure/biometrics/fingerprints/bsp/drivers/Kconfig
```kconfig
menuconfig OPLUS_FINGERPRINT
	bool "OPLUS fingerprint"
	depends on SPI_MASTER
	help
	  Say Y here to enable OPLUS fingerprint support

config OPLUS_FINGERPRINT_GKI_DISABLE
       default n
       tristate "Fingerprint enable gki"

if OPLUS_FINGERPRINT
### platform config
config OPLUS_FINGERPRINT_QCOM
       default n
       tristate "Fingerprint base on QCOM"

config OPLUS_FINGERPRINT_MTK
       default n
       tristate "Fingerprint base on MTK"

### fingerprint sensor config
config OPLUS_FINGERPRINT_FPC
       default n
       tristate "Fingerprint base on fpc capacitive chip"
config OPLUS_FINGERPRINT_GOODIX
       default n
       tristate "Fingerprint base on goodix capacitive chip"
config OPLUS_FINGERPRINT_GOODIX_OPTICAL
       default n
       tristate "Fingerprint base on goodix optical chip"
config OPLUS_FINGERPRINT_SILEAD_OPTICAL
       default n
       tristate "Fingerprint base on silead optical chip"
config OPLUS_FINGERPRINT_EGIS_OPTICAL
       default n
       tristate "Fingerprint base on egis optical chip"
config OPLUS_FINGERPRINT_EGIS
       default n
       tristate "Fingerprint base on egis chip"
config OPLUS_FINGERPRINT_SILEAD
       default n
       tristate "Fingerprint base on silead chip"
config OPLUS_FINGERPRINT_JIIOV_OPTICAL
       default n
       tristate "Fingerprint base on jiiov optical chip"

config OPLUS_FINGERPRINT_JIIOV_CAPACITIVE
       default n
       tristate "Fingerprint base on jiiov capacitive chip"

config OPLUS_FINGERPRINT_CHIPONE
       default n
       tristate "Fingerprint base on chipone chip"

config OPLUS_FINGERPRINT_FOCALTECH
       default n
       tristate "Fingerprint base on focaltech chip"

config OPLUS_FINGERPRINT_CDFPS
       default n
       tristate "Fingerprint base on cdfinger chip"

### fingerprint feature config
config OPLUS_FINGERPRINT_NAVIGATION_ENABLE
       default n
       tristate "Fingerprint navigation function"

config OPLUS_FINGERPRINT_ENABLE_TEE_BINDERCORE
       default n
       tristate "Fingerprint mtk bind big core"
endif #OPLUS_FINGERPRINT
```

## oplus/secure/biometrics/fingerprints/bsp/drivers_kernel/component3.0/qcom/Kconfig
```kconfig
menuconfig OPLUS_FINGERPRINT
	bool "OPLUS fingerprint"
	depends on SPI_MASTER
	help
	  Say Y here to enable OPLUS fingerprint support

if OPLUS_FINGERPRINT
### fingerprint common config
config OPLUS_FINGERPRINT_COMMON
       default n
       tristate "Fingerprint common"
### platform config
config OPLUS_FINGERPRINT_QCOM
       default n
       tristate "Fingerprint base on QCOM"

### fingerprint sensor config
config OPLUS_FINGERPRINT_GOODIX_OPTICAL
       default n
       tristate "Fingerprint base on goodix optical chip"

### fingerprint feature config
config OPLUS_FINGERPRINT_NAVIGATION_ENABLE
       default n
       tristate "Fingerprint navigation function"

config OPLUS_FINGERPRINT_ENABLE_TEE_BINDERCORE
       default n
       tristate "Fingerprint mtk bind big core"

config DRM_PANEL_NOTIFY_FINGERPRINT
       default n
       tristate "Fingerprint UI ready use drm panel notify"

endif #OPLUS_FINGERPRINT
```

## oplus/secure/biometrics/fingerprints/bsp/uff/driver/Kconfig
```kconfig
menuconfig UFF_FINGERPRINT
       tristate "UFF fingerprint"
       depends on SPI_MASTER
       help
       Say Y here to enable UFF fingerprint support

config OPLUS_FINGERPRINT_GKI_ENABLE
       default n
       bool "Fingerprint enable gki"

### platform config
config UFF_FINGERPRINT_QCOM
       default n
       bool "Fingerprint base on QCOM"

config UFF_FINGERPRINT_MTK
       default n
       bool "Fingerprint base on MTK"

### fingerprint feature config
config UFF_FINGERPRINT_ENABLE_TEE_BINDERCORE
       default n
       bool "Fingerprint mtk bind big core"

config UFF_FINGERPRINT_REE_SPI
       default n
       tristate "Fingerprint ree spi"

config FP_SUPPLY_MODE_LDO
       default n
       bool "Fingerprint supply base on pmic's ldo"
```

## techpack/Kconfig
```kconfig
menu "Tech packages"

source "techpack/data/Kconfig"

menu "Xiaomi Camera Configuration"

config CAMERA_NONEDXO
	bool "Enable None-DXO Camera modifications"
	help
	  "Enable None-DXO Camera modifications"

endmenu

endmenu
```
