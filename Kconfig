## Kconfig
```kconfig
# SPDX-License-Identifier: GPL-2.0
#
# For a description of the syntax of this configuration file,
# see Documentation/kbuild/kconfig-language.txt.
#
mainmenu "Linux/$(ARCH) $(KERNELVERSION) Kernel Configuration"

comment "Compiler: $(CC_VERSION_TEXT)"

#ifdef CONFIG_OPLUS_SYSTEM_KERNEL
config OPLUS_SYSTEM_KERNEL_QCOM
  bool "config oplus system feature "
  default y
  help
	Define this config to distinguish between QCOM and MTK platform
#endif /* CONFIG_OPLUS_SYSTEM_KERNEL */

source "scripts/Kconfig.include"

source "init/Kconfig"

source "kernel/Kconfig.freezer"

source "fs/Kconfig.binfmt"

source "mm/Kconfig"

source "net/Kconfig"

source "drivers/Kconfig"

source "fs/Kconfig"

source "security/Kconfig"

source "crypto/Kconfig"

source "lib/Kconfig"

source "lib/Kconfig.debug"

source "techpack/Kconfig"
```

## drivers/misc/kprofiles/Kconfig
```kconfig
# SPDX-License-Identifier: GPL-2.0
#
# Copyright (C) 2021-2023 Dakkshesh <dakkshesh5@gmail.com>.

config KPROFILES
	tristate "Kprofiles Kernel Module"
	default y
	help
	  This allows you to regulate in-kernel activities in a profile-oriented manner.
	  It creates a sysfs node which can be used to change profiles via userspace.
	  It provides 4 profile modes: Disabled, Battery, Balanced and Performance.

	  The former can be used to disable/enable or tune kernel activities according
	  to a profile mode. Check the README.md for more information.

	  It's safe to say Y here, as the driver isn't very demanding and is only
	  used when developer uses the exported API functions in an another driver.

if KPROFILES

config DEFAULT_KP_MODE
	int "Default mode number for kp_mode"
	range 0 3
	default 0
	help
	  Kprofiles will activate this mode during boot-up.

config AUTO_KPROFILES
	bool
	help
	  This option is selected if one of the Auto Kprofiles options is enabled.

choice
	prompt "Auto Kprofiles support"
	default AUTO_KPROFILES_NONE
	help
	  This option toggles the automated mode changer in Kprofile. When enabled,
	  Kprofiles will utilise the notifier API(s) to transition between presently
	  active mode and battery mode based on the device's screen state. Because
	  of notifier API requirements, it is disabled by default.

	  If unsure, select AUTO_KPROFILES_NONE.

config AUTO_KPROFILES_MSM_DRM
	bool "Auto Kprofiles using msm_drm_notifier"
	depends on DRM_MSM
	select AUTO_KPROFILES
	help
	  Select this to enable Kprofile's automatic mode changer via msm_drm_notifier.
	  When this option is enabled, Kprofiles will automatically switch to battery
	  mode when device screen turns off and will switch back to previously active
	  mode when the device wakes up.

config AUTO_KPROFILES_MI_DRM
	bool "Auto Kprofiles using mi_drm_notifier"
	depends on !DRM_MSM
	select AUTO_KPROFILES
	help
	  Select this to enable Kprofile's automatic mode changer via mi_drm_notifier.
	  When this option is enabled, Kprofiles will automatically switch to battery
	  mode when device screen turns off and will switch back to previously active
	  mode when the device wakes up.

config AUTO_KPROFILES_FB
	bool "Auto Kprofiles using fb_notifier"
	depends on FB
	select AUTO_KPROFILES
	help
	  Select this to enable Kprofile's automatic mode changer via fb_notifier.
	  When this option is enabled, Kprofiles will automatically switch to
	  battery mode when device screen turns off and will switch back to
	  previously active mode when the device wakes up.

config AUTO_KPROFILES_NONE
	bool "None"
	help
	  Select this to build Kprofiles without auto Kprofiles.

endchoice

endif # if KPROFILES
```

## drivers/mmc/Kconfig
```kconfig
#
# MMC subsystem configuration
#

menuconfig MMC
	tristate "MMC/SD/SDIO card support"
	depends on HAS_IOMEM
	help
	  This selects MultiMediaCard, Secure Digital and Secure
	  Digital I/O support.

	  If you want MMC/SD/SDIO support, you should say Y here and
	  also to your specific host controller driver.

if MMC

source "drivers/mmc/core/Kconfig"

source "drivers/mmc/host/Kconfig"

endif # MMC

if !MMC

config BOGUS_MMC
	bool "Bogus MMC sysfs"
	help
	  This module exposes a bogus sysfs entry:
	  /sys/class/mmc_host/mmc0/clk_scaling/enable,
	  in order for perfd to operate properly.

endif # !MMC
```

## drivers/power/Kconfig
```kconfig
source "drivers/power/avs/Kconfig"
source "drivers/power/reset/Kconfig"
source "drivers/power/supply/Kconfig"

#ifdef OPLUS_FEATURE_CHG_BASIC
config OPLUS_SM8250_CHARGER
	tristate "OPLUS SM8150 charger driver"
	depends on MFD_SPMI_PMIC
	help
	  Enables support for the oplus charging framework

config OPLUS_SM7250R_CHARGER
	tristate "OPLUS SM7250R charger driver"
	depends on MFD_SPMI_PMIC
	help
	  Enables support for the oplus charging framework

config OPLUS_CALL_MODE_SUPPORT
	bool "OPLUS call mode support"
	help
	  Say Y to include support

config OPLUS_SMART_CHARGER_SUPPORT
	bool "OPLUS smart charger support"
	help
	  Say Y to include support

config OPLUS_CHARGER_WIRELESS_PEN
	bool "OPLUS charger wireless pen"
	help
	  Say Y to include support

source "drivers/power/oplus/Kconfig"
#endif
```

## drivers/soc/Kconfig
```kconfig
menu "SOC (System On Chip) specific Drivers"

source "drivers/soc/actions/Kconfig"
source "drivers/soc/amlogic/Kconfig"
source "drivers/soc/atmel/Kconfig"
source "drivers/soc/bcm/Kconfig"
source "drivers/soc/fsl/Kconfig"
source "drivers/soc/imx/Kconfig"
source "drivers/soc/mediatek/Kconfig"
source "drivers/soc/qcom/Kconfig"
source "drivers/soc/renesas/Kconfig"
source "drivers/soc/rockchip/Kconfig"
source "drivers/soc/samsung/Kconfig"
source "drivers/soc/sunxi/Kconfig"
source "drivers/soc/tegra/Kconfig"
source "drivers/soc/ti/Kconfig"
source "drivers/soc/ux500/Kconfig"
source "drivers/soc/versatile/Kconfig"
source "drivers/soc/xilinx/Kconfig"
source "drivers/soc/zte/Kconfig"
source "drivers/soc/oplus/Kconfig"
#ifdef VENDOR_EDIT
source "drivers/soc/oplus/system/Kconfig"
#endif /* VENDOR_EDIT */

#ifdef OPLUS_FEATURE_SENSOR_SMEM
source "drivers/soc/oplus/sensor/Kconfig"
#endif /* OPLUS_FEATURE_SENSOR_SMEM */

#ifdef OPLUS_FEATURE_ESIM
source "drivers/soc/oplus/misc/Kconfig"
#endif /* OPLUS_FEATURE_ESIM */
endmenu
```

## drivers/soc/oplus/Kconfig
```kconfig
#ifdef OPLUS_FEATURE_TP_BASIC
config OPLUS_COMMON_SOFT
  bool "config oplus common software"
  help
        define this config to get project verion from sharemem.
        Maybe this value is from CDT or dynamic identify by hardware
        id.

source "drivers/soc/oplus/device_info/Kconfig"
#endif /* OPLUS_FEATURE_TP_BASIC */

#ifdef OPLUS_FEATURE_THERMAL_HORAE
source "drivers/soc/oplus/thermal/Kconfig"
#endif /* OPLUS_FEATURE_THERMAL_HORAE */
```

## drivers/video/klapse/Kconfig
```kconfig
config KLAPSE
    bool CONFIG_KLAPSE
    default y
    help
        A simple rgb dynamic lapsing module similar to LineageOS' livedisplay
```

## oplus/kernel/charger/Kconfig
```kconfig
menuconfig OPLUS_CHARGER
	bool "OPLUS charging system"
	depends on I2C
	select REGMAP_I2C
	help
	  Say Y here to enable OPLUS charging system support

if OPLUS_CHARGER
config OPLUS_CHARGER_MTK
	bool "OPLUS charger on MTK"
	help
	  Say Y here to declare charging system is on MTK

config OPLUS_CALL_MODE_SUPPORT
	bool "OPLUS call mode support"
	help
	  Say Y to include support

config OPLUS_SMART_CHARGER_SUPPORT
	bool "OPLUS smart charger support"
	help
	  Say Y to include support

config OPLUS_RTC_DET_SUPPORT
	bool "OPLUS RTC DET SUPPORT"
	default n
	help
	  Say Y to include support

config OPLUS_CHECK_CHARGERID_VOLT
	bool "OPLUS CHECK CHARGERID VOLT"
	default n
	help
	  Say Y to include support

config OPLUS_SHIP_MODE_SUPPORT
	bool "OPLUS_SHIP_MODE_SUPPORT"
	default n
	help
	  Say Y to include support

config OPLUS_CHG_DYNAMIC_CONFIG
	bool "OPLUS_CHG_DYNAMIC_CONFIG"
	default n
	help
	  Say Y to include support

menuconfig OPLUS_CHG
	tristate "OPLUS CHARGER KO module"
	default n
depends on I2C
	select REGMAP_I2C
	help
	  Enables support for the oplus charging v1 framework

source "drivers/power/oplus/v1/Kconfig"

menuconfig OPLUS_CHG_V2
	tristate "OPLUS charging V2 system"
	default n
	depends on I2C
	select REGMAP_I2C
	help
	  Enables support for the oplus charging v2 framework

if OPLUS_CHG_V2
source "drivers/power/oplus/v2/Kconfig"
endif

source "drivers/power/oplus/test-kit/Kconfig"

endif #OPLUS_CHARGER

config OPLUS_CHARGER_WIRELESS_RA9530
	bool "OPLUS charger wireless pen 9530 ic"
	help
	  Say Y to include support

source "drivers/power/oplus/config/Kconfig"
```

## oplus/kernel/charger/config/Kconfig
```kconfig
menuconfig OPLUS_DYNAMIC_CONFIG
	tristate "OPLUS_DYNAMIC_CONFIG"
	default n
	help
	  Say Y or m to include support

if OPLUS_DYNAMIC_CONFIG

config OPLUS_DYNAMIC_CONFIG_CHARGER
	bool "OPLUS_DYNAMIC_CONFIG_CHARGER"
	default n
	depends on OPLUS_DYNAMIC_CONFIG
	help
	  Say Y to include support

endif #OPLUS_DYNAMIC_CONFIG
```

## oplus/kernel/charger/test-kit/Kconfig
```kconfig
config OPLUS_CHG_TEST_KIT
	tristate "Charger Test Kit"
	default n
	help
	  Say Y or M to enable tesk kit
```

## oplus/kernel/charger/v1/Kconfig
```kconfig
config OPLUS_SHORT_C_BATT_CHECK
	bool "OPLUS batt short "
	help
	  Say Y here to declare OPLUS batt short	  

config OPLUS_STANDARD_BATTERY_CHECK_ADC
	bool "OPLUS Official Standard Battery check by ADC"
	help
	  Say Y here to support Official Standard Battery check by ADC

config OPLUS_SHORT_IC_CHECK
	bool "OPLUS short ic"
	help
	  Say Y here to declare OPLUS batt short

config OPLUS_SHORT_HW_CHECK
	bool "OPLUS batt HW SHORT "
	help
	  Say Y here to declare charging system is on MTK

config MTK_DISABLE_GAUGE
	bool "OPLUS MTK disable gauge "
	help
	  Say Y here to include support

config OPLUS_SMOOTH_SOC
	bool "OPLUS config smooth soc "
	help
	  Say Y here to include smooth soc

config OPLUS_SHORT_USERSPACE
	bool "OPLUS batt userspace"
	help
	  Say Y to include support

config OPLUS_CHIP_SOC_NODE
	bool "OPLUS chip soc node"
	help
	  Say Y to include support

config OPLUS_CHARGER_WIRELESS_PEN
        bool "OPLUS charger wireless pen"
        help
          Say Y to include support

config OPLUS_CHARGER_OPTIGA
	bool "OPLUS OPTIGA soc node"
	help
	  Say Y to include support

config OPLUS_MTK_DRM_GKI_NOTIFY_CHG
	default n
	tristate "chg mtk gki notify"

config OPLUS_SM8450_CHARGER
	bool "OPLUS SM8450 charger driver"
	help
	  Enables support for the sm8450 charging
```

## oplus/kernel/charger/v2/Kconfig
```kconfig
config OPLUS_CHG_IC_DEBUG
	bool "Virtual IC layer debug interface"
	help
	  Say Y here to declare virtual IC layer debug interface

config OPLUS_CHG_MMS_DEBUG
	bool "Message subscription layer debug interface"
	help
	  Say Y here to declare message subscription layer debug interface

config OPLUS_SMART_CHARGE
	bool "smart charge"
	help
	  Say Y here to enable smart charge

config OPLUS_DA9313_CHARGER
	bool "DA9313 support"
	help
	  Say Y here to declare DA9313 support

config OPLUS_MP2762_CHARGER
	bool "MP2762 support"
	help
	  Say Y here to declare MP2762 support

config OPLUS_SGM41512_CHARGER
	bool "SGM41512 support"
	help
	  Say Y here to declare SGM41512 support

config OPLUS_PD_MANAGER_CHARGER
	bool "PD_MANAGER support"
	help
	  Say Y here to declare PD_MANAGER support

config OPLUS_ADSP_CHARGER
	bool "ADSP support"
	help
	  Say Y here to declare ADSP support

config OPLUS_MT6375_CHARGER
	bool "MT6375 debug support"
	help
	  Say Y here to declare MT6375 debug support

config OPLUS_ADSP_SM8450_CHARGER
	bool "SM8450 support"
	help
	  Say Y here to declare sm8450 support
menuconfig OPLUS_CHG_VOOCPHY
	bool "OPLUS charging voocphy"
	help
	  Say Y here to enable OPLUS charging system support

if OPLUS_CHG_VOOCPHY
config OPLUS_CHG_VOOCPHY_CHGLIB
	bool "voocphy chglib support"
	help
	  Say Y here to declare voocphy chglib support

config OPLUS_CHG_AP_VOOCPHY
	bool "ap voocphy support"
	depends on OPLUS_CHG_VOOCPHY_CHGLIB
	help
          Say Y here to declare ap voocphy support

config OPLUS_CHG_ADSP_VOOCPHY
	bool "adsp voocphy support"
	depends on OPLUS_CHG_VOOCPHY_CHGLIB
	help
          Say Y here to declare adsp voocphy support

config OPLUS_VOOCPHY_MASTER_SC8547
	bool "master cp sc8547 support"
	depends on OPLUS_CHG_VOOCPHY_CHGLIB && OPLUS_CHG_AP_VOOCPHY
	help
	  Say Y here to declare master cp sc8547 support

config OPLUS_VOOCPHY_SLAVE_SC8547
	bool "slave cp sc8547 support"
	depends on OPLUS_CHG_VOOCPHY_CHGLIB && OPLUS_CHG_AP_VOOCPHY
	help
	  Say Y here to declare slave cp sc8547 support

config OPLUS_VOOCPHY_SC8517
	bool "bidirect cp sc8517 support"
	depends on OPLUS_CHG_VOOCPHY_CHGLIB && OPLUS_CHG_AP_VOOCPHY
	help
	  Say Y here to declare bidirect cp sc8517 support

endif #OPLUS_CHG_VOOCPHY
```

## oplus/kernel/colorctrl/colorctrl/Kconfig
```kconfig
config COLOR_CTRL
	bool "oplus color ctrl device"
	default n
	help
	  Say Y here if you have a color ctrl connected
	  to your system.

	  If unsure, say N.
```

## oplus/kernel/colorctrl/colorctrl_v2/Kconfig
```kconfig
config COLOR_CTRL_V2
	bool "oplus color ctrl device"
	default n
	help
	  Say Y here if you have a color ctrl connected
	  to your system.

	  If unsure, say N.
```

## oplus/kernel/misc/oplus_gpio/Kconfig
```kconfig
#change 'y' to 'n', if you want fo close this controller
config OPLUS_GPIO
    bool "oplus gpio controller"
    default n
    help
      define this config to control oplus gpio.
```

## oplus/kernel/misc/sim_detect/Kconfig
```kconfig
# SPDX-License-Identifier: GPL-2.0-only
# Copyright (C) 2018-2020 Oplus. All rights reserved.
#ifdef OPLUS_FEATURE_SIM_DETECT
config SIM_DETECT
	tristate "SIM_DETECT system"
	default n
	help
	  Say Y here to enable sim detect system support
#endif /* OPLUS_FEATURE_SIM_DETECT */
```

## oplus/kernel/system/Kconfig
```kconfig
# SPDX-License-Identifier: GPL-2.0-only
# Copyright (C) 2018-2020 Oplus. All rights reserved.
config OPLUS_SYSTEM_KERNEL
  bool "config oplus system feature "
  default y
  help
	define this config to add oplus sytstem kernel feature

config OPLUS_ARCH_FILE
  bool "for build directory oplus"
  ---help---
  say Y to buid in

config OPLUS_COMMON_SOFT
  bool "config oplus common software"
  select OPLUS_ARCH_FILE
  help
	define this config to get project verion from sharemem.
	Maybe this value is from CDT or dynamic identify by hardware
	id.

config OPLUS_DEVICE_IFNO
  bool "config devinfo"
  select OPLUS_ARCH_FILE
  help
	define this config to compile devinfo.c for device register

source "drivers/soc/oplus/system/oplus_project/Kconfig"
source "drivers/soc/oplus/system/project_info/Kconfig"
source "drivers/soc/oplus/system/cmdline_parser/Kconfig"

#ifdef OPLUS_FEATURE_MISC
source "drivers/soc/oplus/system/misc/Kconfig"
#endif /* OPLUS_FEATURE_MISC */
```

## oplus/kernel/system/cmdline_parser/Kconfig
```kconfig
# SPDX-License-Identifier: GPL-2.0-only
# Copyright (C) 2018-2020 Oplus. All rights reserved.
config OPLUS_FEATURE_CMDLINE
  tristate "Oplus command line"
  default n
  help
        define this config to get command line.

config OPLUS_FEATURE_ANDROIDBOOT
  tristate "Oplus android boot"
  default n
  help
    define this config to get android boot cmdline.

config OPLUS_FEATURE_FTMMODE
  tristate "Oplus ftm mode"
  default n
  help
      define this config to get ftm mode cmdline.

config OPLUS_FEATURE_CHARGERPRESENT
  tristate "Oplus charger present"
  default n
  help
      define this config to get charger present cmdline.

config OPLUS_FEATURE_BUILDVARIANT
  tristate "Oplus buildvariant"
  default n
  help 
      define this config to get buildvariant cmdline.

config OPLUS_FEATURE_SIMCARDNUM
  tristate "Oplus simcardnum"
  default n
  help
      define this config to get simcardnum cmdline.

config OPLUS_FEATURE_CDT
  tristate "Oplus cdt"
  default n
  help
      define this config to get cdt_integrity cmdline.
```
