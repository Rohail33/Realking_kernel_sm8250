## oplus/kernel/system/misc/Kconfig
```kconfig
# SPDX-License-Identifier: GPL-2.0-only
# Copyright (C) 2018-2020 Oplus. All rights reserved.
config OPLUS_FEATURE_MISC
	bool "oplus misc feature"
	default n
	depends on OPLUS_SYSTEM_KERNEL
	help
      oplus misc feature(trigger dump when user press power key for 4s) .

config PARAM_READ_WRITE
	bool "Param partition read/write support"
	default n
	help
	if you want to read/write the param partition in kernel,
	then you must say Y here.
```

## oplus/kernel/system/oplus_project/Kconfig
```kconfig
# SPDX-License-Identifier: GPL-2.0-only
# Copyright (C) 2018-2020 Oplus. All rights reserved.
config OPLUS_FEATURE_OPROJECT
  tristate "config oplus project info for kernel"
  default n
  help
    define this config to define oplus project
```

## oplus/kernel/thermal/Kconfig
```kconfig
#
# Generic thermal sysfs drivers configuration
#

config HORAE_THERMAL_SHELL
	  tristate "Horae shell temp driver"
	  default y
	  help
	    Provide three thermal zones(front, frame and back) to get real shell temp.
```

## oplus/kernel/touchpanel/kernelFwUpdate/Kconfig
```kconfig
config OPLUS_FW_UPDATE
    tristate "oplus fw update"
    help
        Say Y here if want to add fw update driver for the built-in oplus fw update.
        If unsure, say N.
        To compile this driver as a module, choose M here: the
        module will be called oplus_bsp_fw_update.
```

## oplus/kernel/touchpanel/oplus_touchscreen/Goodix/GT9886/Kconfig
```kconfig
config TOUCHPANEL_GOODIX_GT9886
#   default y
    bool "TP goodix gt9886 IC enable or not for OPLUS"
    ---help---
    say Y to enable driver for Touchpanel useing goodix gt9886

#endif
```

## oplus/kernel/touchpanel/oplus_touchscreen/Kconfig
```kconfig
config TOUCHPANEL_MTK_PLATFORM
	bool "OPLUS platform tp module used"
	help
	  Say Y here if you have mtk-platform.

config TOUCHPANEL_LATE_INIT
	bool "mk6360 pmic init"
	help
	  Say Y here if you have mk6360 pmic.

config TOUCHIRQ_UPDATE_QOS
	bool "OPLUS touchpanel driver update qos"
	help
	  Say Y here if you want to update qos value in irq handler.

config TOUCHPANEL_NEW_SET_IRQ_WAKE
	bool "OPLUS platform tp module used"
	help
	  Say Y here if call enable_irq_wake, can not call disable_irq_nosync

config TOUCHPANEL_OPLUS
	bool "OPLUS tp module"
	help
	  Say Y here if you have touchscreen module.

config OPLUS_TP_APK
	bool "OPLUS apk node create"
	help
	  Say Y here if you use apk for TP.

config TOUCHPANEL_MULTI_NOFLASH
	bool "Multiple noflash TPs using"
	help
	  Say Y here if you have multiple noflash touchscreen.

config TOUCHPANEL_SYNAPTICS
#	default y
	bool "TP Synaptics_IC enable or not for OPLUS"
	---help---
	say Y to enable driver for Touchpanel using Synaptics_IC

config TOUCHPANEL_GOODIX
#	default y
	bool "TP Synaptics_IC enable or not for OPLUS"
	---help---
	say Y to enable driver for Touchpanel using GOODIX_IC

config TOUCHPANEL_SAMSUNG
#	default y
	bool "TP samsung IC enable or not for OPLUS"
	---help---
	say Y to enable driver for Touchpanel using samsung IC

source "drivers/input/touchscreen/oplus_touchscreen/util_interface/Kconfig"

if TOUCHPANEL_SYNAPTICS
source "drivers/input/touchscreen/oplus_touchscreen/Synaptics/Kconfig"
endif

if TOUCHPANEL_GOODIX
source "drivers/input/touchscreen/oplus_touchscreen/Goodix/Kconfig"
endif

if TOUCHPANEL_SAMSUNG
source "drivers/input/touchscreen/oplus_touchscreen/Samsung/Kconfig"
endif
```
