/dts-v1/;

#include "kona-v2.dtsi"

/ {
	model = "Qualcomm Technologies, Inc. kona v2 SoC 20828";
	compatible = "qcom,kona";
	qcom,board-id = <0 0>;
	oplus,dtsi_no = <20828>;
	oplus,pcb_range = <0  56>;
};
