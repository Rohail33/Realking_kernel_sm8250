/dts-v1/;

#include "kona.dtsi"

/ {
	model = "Qualcomm Technologies, Inc. kona v1 SoC 19811";
	compatible = "qcom,kona";
	qcom,board-id = <0 0>;
	oplus,dtsi_no = <19811>;
	oplus,pcb_range = <0  56>;
};
