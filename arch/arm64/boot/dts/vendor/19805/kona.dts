/dts-v1/;

#include "kona.dtsi"

/ {
	model = "Qualcomm Technologies, Inc. kona v1 SoC 19805";
	compatible = "qcom,kona";
	qcom,board-id = <0 0>;
	oplus,dtsi_no = <19805>;
	oplus,pcb_range = <0  56>;
};
