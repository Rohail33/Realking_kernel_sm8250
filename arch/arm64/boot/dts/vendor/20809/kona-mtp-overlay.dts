/dts-v1/;
/plugin/;

#include <dt-bindings/clock/qcom,gcc-kona.h>
#include <dt-bindings/clock/qcom,camcc-kona.h>
#include <dt-bindings/clock/qcom,rpmh.h>
#include <dt-bindings/interrupt-controller/arm-gic.h>

#include "kona-mtp.dtsi"
#include "camera/kona-oem-camera-lemonades_t0.dtsi"
/ {
	model = "Qualcomm Technologies, Inc. kona MTP 20809";
	compatible = "qcom,kona-mtp", "qcom,kona", "qcom,mtp";
	qcom,board-id = <0x10008 0>;
	oplus,dtsi_no = <20809>;
	oplus,pcb_range = <0  56>;

	/*we can add project id to this array,uefi can auto read it,if new project,we add to this array */
	oem,project-id = <20809>;
	oem,project-codename = "kebabt";
    oem,hw-id = <11 12 13 14 15 21 22 23 51 52 53 54 55>;
};

