/dts-v1/;

#include "kona.dtsi"

/ {
	model = "Qualcomm Technologies, Inc. kona v1 SoC 20809";
	compatible = "qcom,kona";
	qcom,board-id = <0 0>;
	oplus,dtsi_no = <20809>;
	oplus,pcb_range = <0  56>;
};
