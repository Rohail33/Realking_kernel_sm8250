/dts-v1/;

#include "kona-v2.dtsi"

/ {
	model = "Qualcomm Technologies, Inc. kona v2 SoC 19821";
	compatible = "qcom,kona";
	qcom,board-id = <0 0>;
	oplus,dtsi_no = <19821>;
	oplus,pcb_range = <0  56>;
};
