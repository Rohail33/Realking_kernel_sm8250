/dts-v1/;
/plugin/;

#include <dt-bindings/clock/qcom,gcc-kona.h>
#include <dt-bindings/clock/qcom,camcc-kona.h>
#include <dt-bindings/clock/qcom,rpmh.h>
#include <dt-bindings/interrupt-controller/arm-gic.h>

#include "kona-mtp.dtsi"
#include "camera/kona-oem-camera-instantnoodle.dtsi"

/ {
	model = "Qualcomm Technologies, Inc. kona MTP 19821";
	compatible = "qcom,kona-mtp", "qcom,kona", "qcom,mtp";
	qcom,board-id = <0x10008 0>;
	oplus,dtsi_no = <19821>;
	oplus,pcb_range = <0  56>;
};

