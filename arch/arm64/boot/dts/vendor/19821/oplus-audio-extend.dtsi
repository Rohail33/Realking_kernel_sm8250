
&soc {
	oplus,audio-drv {
		compatible = "oplus,asoc-audio";
		//for nxp speaker
		oplus,speaker-vendor = "nxp";
		oplus,speaker-i2s-id = <2>;
		oplus,speaker-codec-name = "tfa98xx.2-0035", "tfa98xx.2-0034";
		oplus,speaker-codec-dai-name = "tfa98xx-aif-2-35", "tfa98xx-aif-2-34";
	};
};
